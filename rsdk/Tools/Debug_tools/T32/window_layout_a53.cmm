// t32 Thu Dec 14 14:21:38 2017

 B::
 
 TOOLBAR ON
 STATUSBAR ON
 ;FramePOS 298.29 3.6667 231. 71.
 WinPAGE.RESet
 
 WinPAGE.Create P000
 WinCLEAR
 
 WinPOS 0.14286 0.0 114. 28. 24. 1. W001
 WinTABS 10. 10. 25. 62.
 list
 
 WinPOS 118.57 0.0 51. 25. 0. 0. W000
 Register
 
 WinPOS 0.0 34. 114. 24. 0. 0. W002
 area
 
 WinPOS 173.71 0.083333 54. 27. 0. 0. W004
 PER.view , /DUALPORT
 
 WinPOS 147.0 32.417 83. 29. 0. 1. W005
 WinTABS 26. 10.
 sYmbol.Browse
 
 WinPOS 118.14 29.0 51. 36. 5. 0. W003
 Frame /Locals /Caller
 
 WinPAGE.select P000
 
 ENDDO
