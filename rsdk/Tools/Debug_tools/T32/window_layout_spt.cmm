// T3210019 Thu Apr 17 08:52:59 2014

 B::
 
 TOOLBAR ON
 STATUSBAR ON
 FramePOS 24.714,14.167,,,Maximized
 WinPAGE.RESet
 
 WinPAGE.Create P001
 
 WinCLEAR
 WinPOS 182.86 22.833 80. 13. 0. 0. W000
 SYStem.state
 
 WinPOS 184.0 45.917 86. 25. 0. 0. W001
 AREA
 
 WinPOS 183.0 0.0 87. 19. 0. 0. W006
 Register
 
 WinPOS 0.0 0.16667 87. 41. 13. 1. W005
 Data.dump (0x4000) /NoAscii /DIALOG
 
 WinPOS 0.0 47.25 79. 22. 13. 1. W002
 WinTABS 34. 1. 25. 62.
 List
 
 WinPOS 90.286 0.083333 89. 41. 13. 1. W003
 Data.dump (0x8000) /NoAscii /DIALOG
 
 WinPAGE.select P001
 
 ENDDO
