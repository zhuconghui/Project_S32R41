// @file      RSDK_BBE32_launch.cmm
//
// Copyright 2022, 2024 NXP
// NXP Confidential and Proprietary. This software is owned or controlled by NXP and
// may only be used strictly in accordance with the applicable license terms.  By
// expressly accepting such terms or by downloading, installing, activating and/or
// otherwise using the software, you are agreeing that you have read, and that you
// agree to comply with and are bound by, such license terms.  If you do not agree to
// be bound by the applicable license terms, then you may not retain, install, activate or
// otherwise use the software.
//
// @brief   Opens a Trace32 window for BBE32
//          USAGE: Call this script from Trace32 Master window (A53/M7). Make sure the BBE32 is booted and manually type System.Attach to attach to the BBE32.
//			CALL: do RSDK_BBE32_launch [platform] [full_elf_path] [debug_tools_dir]
//
// UPDATE HISTORY
// REV   DATE         DESCRIPTION OF CHANGE
// ---   ---------    ---------------------
// 0.1   09 Aug 2022  Initial version.

//=========================================================================
// Script environment setup
//=========================================================================

PRIVATE &ppd
PARAMETERS &platform &elfWithPath &dbgToolsPath
&ppd=OS.PPD()

IF SYStem.INSTANCE()!=1.
(
  PRINT %ERROR "This script must be called from Trace32 for ARM window"
  ENDDO
)

//=========================================================================
// Debug Configuration
//=========================================================================


// Open T32 window for BBE32
IF !INTERCOM.PING(BBE32)
(
    TargetSystem.NewInstance BBE32 /ARCHitecture XTENSA /TIMEOUT Infinite
)

// Set title for BBE32 window
InterCom BBE32 TITLE "BBE32"

// Configure Core
if (STRing.ComPare(STRing.LoWeR("&platform"),"s32r45")==TRUE())
(
	InterCom BBE32 Sys.Cpu S32R45-BBE32
)
else if (STRing.ComPare(STRing.LoWeR("&platform"),"s32r41")==TRUE())
(
	InterCom BBE32 Sys.Cpu S32R41-BBE32
)
else if (STRing.ComPare(STRing.LoWeR("&platform"),"saf85xx")==TRUE())
(
	InterCom BBE32 Sys.Cpu SAF85XX-BBE32
)
else if (STRing.ComPare(STRing.LoWeR("&platform"),"saf86xx")==TRUE())
(
  	InterCom BBE32 Sys.Cpu SAF8644-BBE32
)

InterCom BBE32 TASK.CONFIG ~~/demo/xtensa/kernel/xos/xos.t32
InterCom BBE32 MENU.ReProgram ~~/demo/xtensa/kernel/xos/xos.men
InterCom BBE32 TASK.STacK.PATtern 0x55

// Configure Intercom window layout for BBE32
InterCom BBE32 do "&dbgToolsPath/window_layout_bbe32.cmm"

// Fastest JTAG speed
InterCom BBE32 System.JtagClock 40MHz

// Load BBE32 elf symbols
InterCom BBE32 data.load.elf &elfWithPath /noCode


ENDDO
