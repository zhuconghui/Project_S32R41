// T32 Tue Dec 13 12:45:06 2016

 B::
 
 TOOLBAR ON
 STATUSBAR ON
 ;FramePOS 29.375,11.625,,,Maximized
 WinPAGE.RESet
 
 WinPAGE.Create P000
 WinCLEAR
 
 WinPOS 172.13 0.125 54. 13. 0. 1. W000
 WinTABS 20. 15. 20.
 TargetSystem
 
 WinPOS 172.0 17.313 54. 44. 0. 0. W002
 PER
 
 WinPOS 0.0 0.0 90. 20. 14. 1. W004
 WinTABS 10. 10. 25. 62.
 List
 
 WinPOS 0.25 32.75 91. 22. 0. 0. W005
 AREA.Create A000 , 2000.
 AREA.view A000
 
 WinPOS 0.125 24.188 90. 4. 24. 1. W006
 WinTABS 13. 0. 0. 0. 0. 0. 0. 0.
 Break.List
 
 WinPOS 93.5 0.3125 75. 20. 5. 0. W001
 Frame /Locals /Caller
 
 WinPOS 93.375 25.188 75. 33. 0. 1. W003
 WinTABS 26. 26.
 sYmbol.Browse.Var
 
 WinPAGE.select P000
 
 ENDDO
