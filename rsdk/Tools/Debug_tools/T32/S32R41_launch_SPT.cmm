// @file      S32R45_launch_SPT_debug.cmm
// @copyright 2020, 2024 NXP
// NXP Confidential and Proprietary. This software is owned or controlled by NXP and
// may only be used strictly in accordance with the applicable license terms.  By
// expressly accepting such terms or by downloading, installing, activating and/or
// otherwise using the software, you are agreeing that you have read, and that you
// agree to comply with and are bound by, such license terms.  If you do not agree to
// be bound by the applicable license terms, then you may not retain, install, activate or
// otherwise use the software.
//
// @brief   Opens a slave Trace32 window for SPT
//          USAGE: Call this script from master Trace32 window before 
//                 SPT starts execution (before SPT_GBL_CTRL[PG_ST_CTRL] is set)
//
// UPDATE HISTORY
// REV   DATE         DESCRIPTION OF CHANGE
// ---   ---------    ---------------------
// 0.1   14 Jul 2020  Initial version.
// 0.2   21 Nov 2020  Integrated in int_tester

//=========================================================================
// Script environment setup
//=========================================================================
PARAMETERS &param

IF SYStem.INSTANCE()!=1.
(
  PRINT %ERROR "This script must be called from MASTER Trace32 window"
  ENDDO
)

//=========================================================================
// Debug Configuration
//=========================================================================

// Open slave T32 for SPT window
IF !INTERCOM.PING(spt)
(
    SETUP.InterComACKTIMEOUT 5.s ; Increase timeout to maximum
    TargetSystem.NewInstance spt /ARCHitecture SPT /TIMEOUT Infinite
)

    // Set titles for windows
    TITLE "A53"
    InterCom spt TITLE "SPT3.5"


    // Configure debug settings
    InterCom spt SYStem.CPU S32R41
    InterCom spt SYStem.CONFIG.SLAVE ON
    //InterCom spt SYStem.Mode.Attach

    //InterCom spt Break

    InterCom spt DO "&param/window_layout_spt.cmm"
	
	


ENDDO
