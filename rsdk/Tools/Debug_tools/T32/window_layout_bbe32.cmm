// T32_1000003 Tue Jan  7 19:11:48 2020

B::

TOOLBAR   ON
STATUSBAR ON
FramePOS 47.429,4.9167,,,Maximized
WinPAGE.RESet

WinPAGE.Create P000
WinCLEAR

WinPOS 0.57143 38.667 100. 32. 0. 0. W000
area

WinPOS 0.0 0.0 106. 33. 16. 1. W002
WinTABS 16. 10. 25.
list

WinPOS 108.71 0.0 62. 25. 5. 0. W003
Frame /Locals /Caller

WinPOS 110.43 37.25 52. 32. 0. 0. W001
Register

WinPOS 181.86 1.1667 59. 63. 0. 0. W004
PER

WinPAGE.select P000

ENDDO
